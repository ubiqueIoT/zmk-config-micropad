#include <physical_layouts.dtsi>

&{
    encoder_macropad_layout: encoder_macropad_layout {
        compatible = "zmk,physical-layout";
        display-name = "Micropad";
        transform = <&default_transform>;
        kscan = <&kscan0>;
        keys = <
            /* row, column, width, height, x-pos, y-pos, rotation */
            &key_physical_attrs 0 0 100 100 0 0 0
        >;
    };
};
